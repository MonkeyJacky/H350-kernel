## linux-2.6.31.3/drivers/gpu/Kconfig
```kconfig
#
# VIVANTE_GPU support
#

menuconfig	GPU
	tristate "GPU SUPPORT"
	depends on JZSOC

if GPU

source "drivers/gpu/vivante/Kconfig"

endif # GPU
```

## linux-2.6.31.3/drivers/gpu/vivante/Kconfig
```kconfig
#
# VIVANTE_GPU support
#
comment "VIVANTE GPU 2D OR 3D Drivers"

config	VIVANTE_GPU_GC200
	tristate "VIVANTE_GPU_GC200"
	depends on (SOC_JZ4760 || SOC_JZ4760B)
	default n
	help
	  VIVANTE_GPU_GC200

config VIVANTE_GPU_GC860
	tristate "VIVANTE_GPU_GC860"
	depends on SOC_JZ4770
	default n
	help
	  VIVANTE_GPU_GC860
```
